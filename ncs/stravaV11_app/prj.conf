## CMakeLists.txt
```
cmake_minimum_required(VERSION 3.20.0)

find_package(Zephyr REQUIRED HINTS $ENV{ZEPHYR_BASE})
project(stravav11_logic_port)

# Segments/live-race feature (2026-09-11) -- see stravaV11_fw/CMakeLists.txt's
# identical option for the full reasoning (that's the app where this
# actually saves flash; here it's mainly for build-time parity/testing that
# the OFF path still compiles cleanly). Defaults OFF, matching
# stravaV11_fw's own default -- this feature is already descoped
# project-wide. Pass -DSTRAVA_SEGMENTS_ENABLED=ON to build it back in
# (e.g. to re-exercise its native_sim smoke-test coverage).
option(STRAVA_SEGMENTS_ENABLED "Compile in the segments/live-race feature (Segment geometry, SegmentManager, VueCRS/VuePRC segment screens)" OFF)
if(STRAVA_SEGMENTS_ENABLED)
  add_definitions(-DSTRAVA_SEGMENTS_ENABLED)
endif()

# Reuse stravaV10's existing TDD (host-build) abstraction layer for the
# wrapper headers (segger_wrapper.h, math_wrapper.h, assert_wrapper.h,
# task_manager_wrapper.h): they already compile to hardware-free stubs
# under -DTDD. This is a bridge, not the end state -- a later pass should
# replace these with native Zephyr logging/kernel calls once the driver
# phases land.
add_definitions(-DTDD)

set(LIB_ROOT ${CMAKE_CURRENT_SOURCE_DIR}/lib)
set(ADAPTERS_ROOT ${CMAKE_CURRENT_SOURCE_DIR}/adapters)

# RISC-V sandbox research spike (see rv32_emu.h): guest binaries are built
# separately, offline, by tools/riscv_guest/build.sh (needs
# gcc-riscv64-unknown-elf, not part of this app's own build) and loaded
# from disk at runtime -- native_sim is a real Linux process, so this
# smoke test just fopen()s them rather than embedding them as a header.
target_compile_definitions(app PRIVATE
  RISCV_GUEST_BIN_DIR="${CMAKE_CURRENT_SOURCE_DIR}/tools/riscv_guest"
)

target_include_directories(app PRIVATE
  ${LIB_ROOT}
  ${LIB_ROOT}/TDD
  ${LIB_ROOT}/TDD/nordic
  ${LIB_ROOT}/TDD/scheduler
  ${LIB_ROOT}/source
  ${LIB_ROOT}/source/routes
  ${LIB_ROOT}/source/model
  ${LIB_ROOT}/source/display
  ${LIB_ROOT}/source/parsers
  ${LIB_ROOT}/source/sensors
  ${LIB_ROOT}/source/maps
  ${LIB_ROOT}/source/riscv
  ${LIB_ROOT}/libraries/utils
  ${LIB_ROOT}/libraries/kalman
  ${LIB_ROOT}/libraries/VParser
  ${LIB_ROOT}/libraries/komoot
  ${LIB_ROOT}/libraries/filters
  ${LIB_ROOT}/libraries/TinyGPSPlus
  ${LIB_ROOT}/libraries/AdafruitGFX
  ${LIB_ROOT}/libraries/AdafruitGFX/Fonts
  ${LIB_ROOT}/source/vue
  ${ADAPTERS_ROOT}
)

target_sources(app PRIVATE
  ${LIB_ROOT}/source/g_structs.c
  ${LIB_ROOT}/source/routes/Points.cpp
  ${LIB_ROOT}/source/routes/Vecteur.cpp
  ${LIB_ROOT}/source/routes/ListePoints.cpp
  ${LIB_ROOT}/source/routes/Parcours.cpp
  ${LIB_ROOT}/source/model/PowerZone.cpp
  ${LIB_ROOT}/source/model/RRZone.cpp
  ${LIB_ROOT}/source/model/SufferScore.cpp
  ${LIB_ROOT}/source/model/UserSettings.cpp
  ${LIB_ROOT}/source/model/Locator.cpp
  ${LIB_ROOT}/source/display/Zoom.cpp
  ${LIB_ROOT}/source/display/notifications.c
  ${LIB_ROOT}/source/maps/map_tile.c
  ${LIB_ROOT}/source/maps/map_render.cpp
  ${LIB_ROOT}/source/riscv/rv32_emu.c
  ${LIB_ROOT}/libraries/utils/utils.c
  ${LIB_ROOT}/libraries/utils/WString.cpp
  ${LIB_ROOT}/libraries/kalman/kalman_ext.cpp
  ${LIB_ROOT}/libraries/kalman/UDMatrix.cpp
  ${LIB_ROOT}/libraries/VParser/VParser.cpp
  ${LIB_ROOT}/libraries/komoot/komoot_nav.c
  ${LIB_ROOT}/libraries/filters/order1_filter_tdd.c
  ${LIB_ROOT}/libraries/TinyGPSPlus/TinyGPS++.cpp
  ${LIB_ROOT}/libraries/AdafruitGFX/Adafruit_GFX.cpp
  ${LIB_ROOT}/libraries/AdafruitGFX/Print.cpp
  ${LIB_ROOT}/source/vue/ZephyrGFX.cpp
  ${LIB_ROOT}/source/vue/Screenutils.cpp
  ${LIB_ROOT}/source/vue/MenuObjects.cpp
  ${LIB_ROOT}/source/vue/Menuable.cpp
  ${LIB_ROOT}/source/vue/VueDebug.cpp
  ${LIB_ROOT}/source/vue/VueGPS.cpp
  ${LIB_ROOT}/source/vue/VueFEC.cpp
  ${LIB_ROOT}/source/vue/VuePRC.cpp
  ${LIB_ROOT}/source/vue/VueCRS.cpp
  ${LIB_ROOT}/source/vue/Vue.cpp
  ${ADAPTERS_ROOT}/debug_screen_data_stub.cpp
  src/menu_content.cpp
  ${ADAPTERS_ROOT}/fram_stub.c
  ${ADAPTERS_ROOT}/gps_mgmt_stub.cpp
  ${ADAPTERS_ROOT}/millis_zephyr.c
  ${ADAPTERS_ROOT}/drv_ws2812_stub.c
  ${ADAPTERS_ROOT}/gui_connector.c
  src/globals.cpp
  src/main.cpp
)

if(STRAVA_SEGMENTS_ENABLED)
  target_sources(app PRIVATE
    ${LIB_ROOT}/source/routes/Segment.cpp
    ${LIB_ROOT}/source/display/SegmentManager.cpp
  )
endif()
```

## prj.conf
```kconfig
# Ported business logic is C++ and leans on the STL (std::list, std::vector,
# std::sort) via stravaV10's routes/*, so we need a real C++ runtime + libc,
# not Zephyr's minimal libc.
CONFIG_CPP=y
CONFIG_STD_CPP17=y
# routes/* uses std::list/vector/sort -- Zephyr's default "minimal" C++ lib
# only provides new/delete, not the STL. This pulls in the real one (host
# libstdc++ on native_sim; newlib-based libstdc++ once we build for the DK).
CONFIG_REQUIRES_FULL_LIBCPP=y

CONFIG_MAIN_STACK_SIZE=8192
CONFIG_HEAP_MEM_POOL_SIZE=32768

CONFIG_ASSERT=y

# Picolibc (the DK's default libc) drops %f/%g printf support unless asked
# for; without this, floats print as the literal string "*float*".
CONFIG_PICOLIBC_IO_FLOAT=y
```

## src/globals.cpp
```c
/*
 * Global objects that stravaV10's Model.cpp normally defines and that this
 * logic-only slice still needs a definition for (PowerZone reads FTP from
 * u_settings). Model.cpp itself isn't ported yet -- see CLAUDE.md.
 */

#include "UserSettings.h"
#include "Points.h"
#include "ZephyrGFX.h"
#include "vue_global.h"
#include "menu_host.h"
#include "att_global.h"
#include "Locator.h"
#if defined(STRAVA_SEGMENTS_ENABLED)
#include "Segment.h"
#include "SegmentManager.h"
#endif
#include "PowerZone.h"
#include "RRZone.h"
#include "SufferScore.h"
#include "g_structs.h"

UserSettings u_settings;

/* GFX port Phase D: the global `vue` MenuObjects.cpp/Menuable.cpp/
 * VueDebug.cpp/VueGPS.cpp/VueFEC.cpp/VuePRC.cpp/VueCRS.cpp draw into --
 * now the real, fully-assembled `Vue` class -- see vue_global.h's own
 * comment. Not yet `.init()`'d or `.refresh()`'d from anywhere in this
 * app's own smoke test main() -- see main.cpp's own Vue test block for
 * what's exercised directly instead. */
Vue vue;

/* GFX port Phase D: the global Menuable instance menu_content.cpp builds
 * the menu tree against -- see menu_host.h's own comment for why this is
 * separate from `vue`. */
MenuHost menu;

/* GFX port Phase D: see att_global.h's own comment -- stays zero-
 * initialized until Attitude (not ported) exists to populate it. */
SAtt att;

/* GFX port Phase D: VueDebug.cpp's global `locator` (via
 * Locator::displayGPS2()) and `mes_segments` (real ListeSegments, just
 * empty until real route/segment loading is wired into this app --
 * neither app does that yet). Distinct from main.cpp's own local
 * `Locator locator;` in its GPS smoke test, which stays local since
 * nothing else needs to share it. */
Locator locator;
#if defined(STRAVA_SEGMENTS_ENABLED)
ListeSegments mes_segments;

/* GFX port Phase D: VuePRC.cpp's global -- the same SegmentManager class
 * ported in Phase 1 (segment scoring/ordering bookkeeping), now with a
 * real, live instance. Starts empty (getNbSegs()==0), same "no ride data
 * yet" honesty as zPower/rrZones/suffer_score above -- nothing loads real
 * segments into it yet. */
SegmentManager segMngr;
#endif

/* GFX port Phase D: VueFEC.cpp's globals -- zPower/rrZones are the same
 * PowerZone/RRZone classes already ported (Phase 1) and already
 * exercised by main.cpp's own smoke test (as local objects there); these
 * are the real, shared instances a screen would read from. suffer_score/
 * powerVector likewise. All start at their default-constructed/
 * zero-initialized state -- honest "no ride data yet" until Boucle*
 * (not ported) or something else feeds them. */
PowerZone zPower;
RRZone rrZones;
SufferScore suffer_score;
sPowerVector powerVector;

// Also normally defined in Model.cpp, even though they belong to Points.h's
// object-count bookkeeping.
int Point2D::objectCount2D = 0;
int Point::objectCount = 0;
```

## src/menu_content.cpp
```c
/*
 * GFX port Phase D: Menuable::initMenu()'s definition for stravaV11_app
 * (native_sim) -- see Menuable.cpp's own top-of-file note for why this
 * lives in its own file rather than in Menuable.cpp itself.
 *
 * Deliberately NOT stravaV10's original menu tree: that one's root page
 * has mode-switching items (Mode FEC/CRS/PRC/Zwift/DBG) tied to
 * boucle__change_mode()/Boucle* state machines, which aren't ported (the
 * single largest remaining item in the whole project -- see the GFX port
 * plan in todo.md, which deliberately decouples this UI port from that).
 * This tree covers only what's genuinely real and testable right now:
 * the settings/pairing subtree, using this port's own real UserSettings
 * (already ported, Phase 1) directly -- not stubbed. ANT+ pairing itself
 * is stubbed here (ant_dm_demo.c is stravaV11_fw-only, real ANT+ hardware
 * code that doesn't exist on native_sim); the real wiring lives in
 * stravaV11_fw's own copy of this file.
 *
 * Also a real, deliberate scope cut from stravaV10's original pairing
 * flow: stravaV10's "Pair HRM" opened a MenuPagePairing showing live
 * discovered candidates as selectable items (via
 * ant_device_manager_get_sensors_list()). ant_dm_demo.h/.c (this port's
 * real ANT+ device manager) doesn't yet expose an equivalent accessor for
 * its candidate list -- only a log-only ant_dm_demo_search_list(). So for
 * now, the menu's pairing items only trigger a search; picking a
 * discovered candidate is still done via cmd_console.c's "DM LIST"/
 * "DM PICK <n>" commands, not from the menu. A real, flagged gap, not
 * silently skipped -- exposing that candidate list is natural follow-up
 * work once this lands.
 */

#include "Menuable.h"
#include "MenuObjects.h"
#include "UserSettings.h"
#include "menu_host.h"
#include "segger_wrapper.h"

extern UserSettings u_settings;

static MenuPageItems m_root_page(menu, nullptr);
static MenuPageSetting page_value(menu, &m_root_page);

/* Test-observable: how many times each pairing stub was invoked, and with
 * what would-be sensor type -- lets the native_sim smoke test verify menu
 * dispatch reaches the right callback, without needing the real ANT+
 * stack this file can't have on native_sim. */
int g_menu_test_pair_hrm_calls;
int g_menu_test_pair_bsc_calls;
int g_menu_test_pair_fec_calls;

static eFuncMenuAction _pair_hrm(int var)
{
	g_menu_test_pair_hrm_calls++;
	LOG_INFO("menu: would call ant_dm_demo_search_start(HRM)");
	return eFuncMenuActionEndMenu;
}

static eFuncMenuAction _pair_bsc(int var)
{
	g_menu_test_pair_bsc_calls++;
	LOG_INFO("menu: would call ant_dm_demo_search_start(BSC)");
	return eFuncMenuActionEndMenu;
}

static eFuncMenuAction _pair_fec(int var)
{
	g_menu_test_pair_fec_calls++;
	LOG_INFO("menu: would call ant_dm_demo_search_start(FEC)");
	return eFuncMenuActionEndMenu;
}

static int get_cur_ftp(int var)
{
	return u_settings.getFTP();
}

static int set_cur_ftp(int var)
{
	sUserParameters *settings = user_settings_get();

	settings->FTP = (uint16_t)var;
	u_settings.writeConfig();

	return 0;
}

static eFuncMenuAction _set_ftp(int var)
{
	sSettingsCallbacks callbacks = {get_cur_ftp, set_cur_ftp};

	page_value.setCallbacks(callbacks);
	page_value.setName("FTP:");

	return eFuncMenuActionNone;
}

static int get_cur_weight(int var)
{
	return u_settings.getWeight();
}

static int set_cur_weight(int var)
{
	sUserParameters *settings = user_settings_get();

	settings->weight = (uint16_t)var;
	u_settings.writeConfig();

	return 0;
}

static eFuncMenuAction _set_weight(int var)
{
	sSettingsCallbacks callbacks = {get_cur_weight, set_cur_weight};

	page_value.setCallbacks(callbacks);
	page_value.setName("Weight:");

	return eFuncMenuActionNone;
}

void Menuable::initMenu(void)
{
	MenuItem item_prm(m_root_page, "Pair HRM", _pair_hrm);
	MenuItem item_psc(m_root_page, "Pair BSC", _pair_bsc);
	MenuItem item_pec(m_root_page, "Pair FEC", _pair_fec);
	MenuItem item_ftp(m_root_page, "Set FTP", _set_ftp, &page_value);
	MenuItem item_wei(m_root_page, "Set Weight", _set_weight, &page_value);

	m_root_page.addItem(item_prm);
	m_root_page.addItem(item_psc);
	m_root_page.addItem(item_pec);
	m_root_page.addItem(item_ftp);
	m_root_page.addItem(item_wei);

	p_root_page = &m_root_page;

	this->closeMenu();
}
```

## src/notifications_stub.c
```c
/*
 * Placeholder for the WS2812 LED notification driver (drivers/drv_ws2812.c +
 * source/display/notifications.c in stravaV10), not ported yet. SegmentManager
 * calls notifications_segNotify() to drive the status LED; until the LED
 * driver phase, this just no-ops so the business-logic layer links standalone.
 */

#include "notifications.h"

void notifications_segNotify(neo_sb_seg_params *orders)
{
	(void)orders;
}
```
